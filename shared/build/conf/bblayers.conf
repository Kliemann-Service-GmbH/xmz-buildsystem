## shared/build/conf/bblayers.conf
```bitbake
# LAYER_CONF_VERSION is increased each time build/conf/bblayers.conf
# changes incompatibly
POKY_BBLAYERS_CONF_VERSION = "2"

BBPATH = "${TOPDIR}"
BBFILES ?= ""
BBLAYERS ?= " \
  /home/build/poky/meta \
  /home/build/poky/meta-poky \
  /home/build/poky/meta-yocto-bsp \
  /home/build/shared/meta-openembedded/meta-oe \
  /home/build/shared/meta-bsp_lemaker \
  /home/build/shared/meta-xmz \
  /home/build/shared/meta-rust-bin \
  "

BBLAYERS_NON_REMOVABLE ?= " \
  /home/build/poky/meta \
  /home/build/poky/meta-poky \
  "
```
